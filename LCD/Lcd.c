/*************文件信息*************************************************** 
;** 文件名称： LCD——192x64.c
;** 功能说明：
;** Copyright:           
;** Modified by:       	
;** 版本 信息:  v1.00
    	2011.7.18	   郭建强 
		    	
;** 文件 描述：上海众金
******************************************************************************************/	
#include "Lcd.h"
#include "config.h"

TCOLOR  	gui_disp_buf[GUI_LCM_YMAX/8][GUI_LCM_XMAX];				// 声明GUI显示缓冲区


/*特殊标点符号 连接号 "–" */
const unsigned char bdlianjiehao[32] = {
0x00,0x00,0x00,0x00,0x00,0x00,0x00,0x00,0x00,0x00,0x00,0x00,0x00,0x00,0x00,0x00,
0x00,0x00,0x00,0x00,0x00,0x02,0x02,0x02,0x02,0x02,0x02,0x00,0x00,0x00,0x00,0x00,
};
/*波浪号"﹏﹏"*/
//const unsigned char bdbolanghao[32]	 = {0x00,0x00,0x00,0x00,0x00,0x00,0x00,0x00,0x00,0x00,0x00,0x00,0x00,0x00,0x00,0x00,
//0x30,0x10,0x08,0x04,0x02,0x04,0x08,0x10,0x20,0x40,0x40,0x20,0x10,0x08,0x04,0x06};


const uint8_t ASCII8x16_Table[] = {
0x00, 0x00, 0x00, 0x00, 0x00, 0x00, 0x00, 0x00, 0x00, 0x00, 0x00, 0x00, 0x00, 0x00, 0x00, 0x00, 
0x00, 0x00, 0x00, 0xf8, 0x00, 0x00, 0x00, 0x00, 0x00, 0x00, 0x00, 0x33, 0x30, 0x00, 0x00, 0x00, 
0x00, 0x10, 0x0c, 0x06, 0x10, 0x0c, 0x06, 0x00, 0x00, 0x00, 0x00, 0x00, 0x00, 0x00, 0x00, 0x00, 
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0x00, 0x00, 0x00, 0x00, 0x00, 0x00, 0x00, 0x00, 0x00, 0x00, 0x00, 0x00, 0x00, 0x00, 0x00, 0x00};

const uint8_t ASCII8x8_Table[] = {
0x00, 0x00, 0x00, 0x00, 0x00, 0x00, 0x00, 0x00, 0x00, 0xbf, 0x00, 0x00, 0x00, 0x00, 0x00, 0x00, 
0x07, 0x00, 0x07, 0x00, 0x00, 0x00, 0x00, 0x00, 0x28, 0xf8, 0x2e, 0x28, 0xf8, 0x2e, 0x08, 0x00, 
0x00, 0x46, 0x89, 0xff, 0x89, 0x72, 0x00, 0x00, 0x06, 0x09, 0xc6, 0x38, 0x66, 0x91, 0x60, 0x00, 
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0x10, 0x08, 0x08, 0x10, 0x20, 0x20, 0x10, 0x00, 0xff, 0xff, 0xff, 0xff, 0xff, 0xff, 0xff, 0xff};



LCD_typeDef	 LCD;
#define FLASH_OFFSET_ASC        0x3b0000  //0x000000 
#define FLASH_OFFSET_GB2312     FLASH_OFFSET_ASC+0x000600     //0x010600 
#define FLASH_OFFSET_U_TO_G     FLASH_OFFSET_GB2312+0x03FE40  //0x050440
#define FLASH_OFFSET_G_TO_U     FLASH_OFFSET_U_TO_G+0x00A34C  //0x05A78C
//static unsigned short  Lcd_Rcurx=0;
//static unsigned short  Lcd_Rcury=0;
/****************************************************************************************
  操作方法：
    1. 设定坐标
    2. 调用函数

******************************************************************************************/


/********************************************************************************************************
** 函数名称:  硬件相关基本函数   改变硬件时应该修改此函数
********************************************************************************************************/
void LCD_RW(unsigned char wr)                //LCD  0-读 否则 写
{
     if(!wr) GPIOD->ODR &= ~(1 << 9);	
     else   GPIOD->ODR |=  (1 << 9);
} 
void LCD_CD(unsigned char dat)               //LCD  0-写命令 1-写数据
{
     if (dat) GPIOD->ODR |= (1 << 8);		
     else	GPIOD->ODR &= ~(1 << 8);			
} 
void LCD_EN(unsigned char en)                //LCD 操作使能
{
  if (en) GPIOD->ODR |= (1 << 10);
  else	  GPIOD->ODR &= ~(1 << 10);
} 
void LCD_WrByte(unsigned char dat)            // 写字节
{
  GPIOD->ODR = ((GPIOD->ODR & 0xFF00) | dat);	
}
unsigned char  LCD_RdByte(void)  // 读字节
{
  return (  (GPIOD->IDR & 0x00FF)  );	      
}
void LCD_RST(unsigned char en)               // 复位
{
   if (en==0)  GPIOD->ODR &= ~(1 << 11);
   else	    GPIOD->ODR |=  (1 << 11);
}

void LCD_ShipCS(unsigned cs)                  //片选 0,1,2;  3-不选  有3个芯片封装在内  每个芯片 64*64
{
   switch(cs){
         case 0:// 选择第1区
                GPIOD->ODR &= ~(1 << 13);// CS1 low
                GPIOD->ODR &= ~(1 << 12);// CS2 low
                break;
         case 1:// 选择第2区
                GPIOD->ODR |= (1 << 13);	
                GPIOD->ODR &= ~(1 <<12);// CS2 low
                break;
         case 2:// 选择第3区
                GPIOD->ODR &= ~(1 << 13);	// CS1 low
                GPIOD->ODR |=  (1 << 12); // CS2 high
                break;
         case 3:// 3-不选
                GPIOD->ODR |= (1 << 13);	
                GPIOD->ODR |= (1 << 12);
                break;
			}  
}
/********************************************************************************************************
** 函数名称: void IsrTimeLcd(unsigned char ms)
** 功能描述:   中断调用
** 输　入: 	ms：计时  
** 输　出:  
** 说明：    
********************************************************************************************************/
void IsrTimeLcd(unsigned char ms)
{
 

} 
void LCD_Delay1us(unsigned short us)
{
   unsigned char k;
   while(us--){
	      for(k=0;k<2;k++);	 
   }
}
/*********************************************************************************************************
** 函数名称:  unsigned char LCD_RDStatusReg(unsigned char cs_chip)// 
** 功能描述:  读状态寄存器 
** 输　入: 	  
** 输　出:    bit7: 1-忙  bit6: 1-显示被关闭  bit5: 1- 复位中  bit4-0 保留
** 说  明：	 
********************************************************************************************************/
unsigned char LCD_RDStatusReg(unsigned char cs_chip)// 
{
	unsigned char status=0;
	LCD_ShipCS(cs_chip);  	
	LCD_EN(1);                
	LCD_CD(1);                 	
	LCD_RW(1);                
	status=LCD_RdByte();      
	LCD_Delay1us(1); 	
	LCD_EN(0);               
	LCD_Delay1us(2);
	return status;
 
} 
/*********************************************************************************************************
** 函数名称: unsigned char  LCD_Busy(void)
** 功能描述:  返回非0表示忙
** 输　入: 	  
** 输　出: 
** 说  明：	 高电平表示忙
********************************************************************************************************/
unsigned char  LCD_Busy(void)//
{
	uint8_t status=0;
//	status=LCD_RDStatusReg(0)|LCD_RDStatusReg(1)|LCD_RDStatusReg(2);
//   return (status&0x80); 
   return 0; 
} 
/*********************************************************************************************************
** 函数名称:  void LCD_WRReg(unsigned char cs_chip,unsigned char reg)
** 功能描述:   写寄存器
** 输　入: 	  
** 输　出: 
** 说  明：	 
********************************************************************************************************/
void LCD_WRReg(unsigned char cs_chip,unsigned char reg)
{   
   unsigned short  t=0;  
   while(LCD_Busy()){ 
	   LCD_Delay1us(1); 
	   t++;
	   if(t>500)	      
	       break; 
   }
	 LCD_Delay1us(10);
   LCD_ShipCS(cs_chip);  	
	 LCD_EN(1);
	 LCD_CD(0);
	 LCD_RW(0);            
	 LCD_WrByte(reg);      LCD_Delay1us(2); 
	 LCD_EN(0);            LCD_Delay1us(6); 
}
/*********************************************************************************************************
** 函数名称:  void LCD_WRRam(unsigned char cs_chip,unsigned char dat)  //写数据
** 功能描述:  写数据
** 输　入: 	  
** 输　出: 
** 说  明：	 
********************************************************************************************************/
void LCD_WRRam(unsigned char cs_chip,unsigned char dat)  //写数据
{
   unsigned short  t=0;  
   while(LCD_Busy()){ 
	   LCD_Delay1us(1); 
	   t++;
	   if(t>500)	      
	       break; 
   }
	 	   LCD_Delay1us(10); 

   LCD_ShipCS(cs_chip);  	
	 LCD_EN(1);                	 
	 LCD_CD(1);
	 LCD_RW(0);								
	 LCD_WrByte(dat);          LCD_Delay1us(2); 
	 LCD_EN(0);                LCD_Delay1us(6); 
} 
/*********************************************************************************************************
** 函数名称: void  LCD_On(unsigned char en)
** 功能描述:  屏幕开
** 输　入: 	    
** 输　出: 
** 说  明：	 
********************************************************************************************************/
void  LCD_On(unsigned char en)
{
   if(en){
   	    LCD_WRReg (0,0x3f);       //开显示
	      LCD_WRReg (1,0x3f);
	      LCD_WRReg (2,0x3f);
   }
   else{
        
        
        
   }	
}

void LCD_Initialize(void)
{
							
	GPIO_InitTypeDef GPIO_InitStructure;

//	GPIO_PinRemapConfig(GPIO_Remap_SWJ_JTAGDisable, ENABLE);	
	RCC_APB2PeriphClockCmd(RCC_APB2Periph_GPIOD, ENABLE)  ; 
	//RS
	GPIO_InitStructure.GPIO_Pin = GPIO_Pin_8;
	GPIO_InitStructure.GPIO_Mode = GPIO_Mode_Out_PP;
	GPIO_InitStructure.GPIO_Speed = GPIO_Speed_50MHz;
	GPIO_Init(GPIOD, &GPIO_InitStructure);
	//RW
	GPIO_InitStructure.GPIO_Pin = GPIO_Pin_9;
	GPIO_Init(GPIOD, &GPIO_InitStructure);
	//EN
	GPIO_InitStructure.GPIO_Pin = GPIO_Pin_10;
	GPIO_Init(GPIOD, &GPIO_InitStructure);
	//RST
	GPIO_InitStructure.GPIO_Pin = GPIO_Pin_11;
	GPIO_Init(GPIOD, &GPIO_InitStructure);
	//CS1
	GPIO_InitStructure.GPIO_Pin = GPIO_Pin_13;
	GPIO_Init(GPIOD, &GPIO_InitStructure);
	//CS2
	GPIO_InitStructure.GPIO_Pin = GPIO_Pin_12;
	GPIO_Init(GPIOD, &GPIO_InitStructure);


	//D0-D7
	GPIO_InitStructure.GPIO_Pin = GPIO_Pin_0 | GPIO_Pin_1 | GPIO_Pin_2 | GPIO_Pin_3 | GPIO_Pin_4 | GPIO_Pin_5 | GPIO_Pin_6 | GPIO_Pin_7 ;

	GPIO_Init(GPIOD, &GPIO_InitStructure);

	LCD_RST(0);
	LCD_Delay1us(50);

	LCD_RST(1);	
	LCD_Delay1us(50);  //LCD复位

	/*清一下屏否则会先花一下*/
	LCD_Fill(0);
	LCM_Reflsh(1);

	LCD_WRReg (0,0x3f);       //开显示
	LCD_WRReg (1,0x3f);
	LCD_WRReg (2,0x3f);

}


/********************************************************************************
** 函数名称: void LCM_Reflsh(unsigned char all)	
** 功能描述: 
** 输　入: 	  all==0   每次执行函数只刷新64行中得8行 否则 全部刷新 
** 输　出: 
** 说  明：	  此函数放主程序循环刷新	 
              显示放内存操作（8页x192列，1536字节，主频36MHz，一屏刷新8次，1.4ms/次）;
 
  	
  页	 列地址
  1    1-----------------------------192x1
  2    193---------------------------192x2
  3    385---------------------------192x3
  4    577---------------------------192x4
  5    769---------------------------192x5
  6    961---------------------------192x6
  7    1153--------------------------192x7
  8    1345--------------------------192x8
  
        第一列                      第192列
          D0 ........................ D0
          .  ........................ .
  第1页   .  ........................ .
          .  ........................ .
          D7 ........................ D7

  以下7页的排列顺序与第一页相同

 *******************************************************************************/																	  
void LCM_Reflsh(unsigned char all)		//																		  
{	
	static unsigned char page=0; 
	unsigned char i=0,n=0;
 	if(all)all=8;
 	else all=1;
 	while(all--){
    for( n=0;n<3;n++){  		 
     	LCD_WRReg (n,0xb8+page);            
	    LCD_WRReg (n,0x40+0);			 
	    for(i=0;i<64;i++) {	
	        LCD_WRRam (n, LCD.buf[page][n*64+i]);	 		 
     	}
    }
	  page++;
	  if(page>=8)page=0;	 
	}
}
/********************************************************************************
   全屏填充数据，主频36MHz，执行时间约 ms
 *******************************************************************************/
void LCD_Fill (unsigned char dat)
{	
  unsigned char i=0,j=0;
  for(i=0;i<8;i++)
     for(j=0;j<192;j++)LCD.buf[i][j]=dat;
}

/*----------------------------------------------
坐标定位程序
参数XPage  定位页    取值0--7    共8页
    Y       横向定位    取值0-191    共192列
-----------------------------------------------*/
void LCD_XY_SET(unsigned char X,unsigned char YPage)
{
    if(X<64)        //在第一个区中
    {
			LCD_WRReg(0,FIRST_PAGE|YPage);
			LCD_WRReg(0,START_YADD|X);
    }
    else if(X<128)    //在第二个区中
    {
			LCD_WRReg(1,FIRST_PAGE|YPage);
			LCD_WRReg(1,START_YADD|X-64);			
    }
    else if(X<192)    //在第三个区中
    {
			LCD_WRReg(2,FIRST_PAGE|YPage);
			LCD_WRReg(2,START_YADD|X-128);			
    }
}
/*********************************************************************************************************
** 函数名称: void  LCD_Dot(unsigned char x0,unsigned char y0,unsigned char rev)
** 功能描述: 画点   左上角为0 右下角为（LCD_PIXELx，LCD_PIXELy） 
** 输　入: dot>0 写1 否则0	   rev>0 反显
** 输　出: 
** 说  明：	 
********************************************************************************************************/
void  LCD_Dot(unsigned char x0,unsigned char y0,unsigned char rev)
{ 
  unsigned char dat;    
  if(x0>=LCD_PIXELx)return;  
  if(y0>=LCD_PIXELy)return;
 
  dat=LCD.buf[y0/8][x0];  
  if(rev==0)dat|=1<<(x0%8);
  else dat&=~(1<<(x0%8));
  LCD.buf[y0/8][x0]=dat;  
}

/***********************************************************************
* 名称：LCD_FillAll()
* 功能：LCD填充。以图形方式进行填充，起始地址为0x0000。
* 入口参数：dat		要填充的数据
* 出口参数：无
***********************************************************************/
void  LCD_FillAll(uint8 dat)
{  
	unsigned char all=8;
	static unsigned char page=0; 
	unsigned char i=0,n=0;

	
 	while(all--)
	{
    for( n=0;n<3;n++)
		{  		 
     	LCD_WRReg (n,0xb8+page);            
	    LCD_WRReg (n,0x40+0);			 
	    for(i=0;i<64;i++) 
			{	
	        LCD_WRRam (n, gui_disp_buf[page][n*64+i]);	 		 
     	}
    }
		
	  page++;
		
	  if(page>=8)
			page=0;	 
	}
}
unsigned char LCD_READ_RAM(unsigned char x,unsigned char y)
{
    unsigned char temp;
    LCD_XY_SET(x,y);
    LCD_RW(1);    //设置为读数据
		 LCD_CD(1);
		 LCD_WrByte(0xFF);          LCD_Delay1us(1); 
    LCD_EN(0);
    LCD_EN(1);
    temp     =LCD_RdByte();    
    LCD_EN(0);
    return temp;
}


/****************************************************************************
* 名称：LCD_UpdatePoint()
* 功能：在指定位置上画点，刷新某一点。
* 入口参数： x		指定点所在列的位置
*           y		指定点所在行的位置
* 出口参数：返回值为1时表示操作成功，为0时表示操作失败。
* 说明：操作失败原因是指定地址超出缓冲区范围。
****************************************************************************/
void  LCD_UpdatePoint(uint32 x, uint32 y)
{  
	uint32  addr; 
 
	unsigned char i,j,k;
	i=y&0xF8;//i是X/8的余数
	y>>=3;    //x是X/8的商
   LCD_XY_SET(x,y);
	LCD_WRRam (x/64, gui_disp_buf[y][x>>3]	);	 		 


}



/****************************************************************************
*                    与LCM相关的GUI接口函数
****************************************************************************/


/****************************************************************************
* 名称：GUI_FillSCR()
* 功能：全屏填充。直接使用数据填充显示缓冲区。
* 入口参数：dat		填充的数据(对于黑白色LCM，为0的点灭，为1的点显示)
* 出口参数：无
****************************************************************************/
void  GUI_FillSCR(uint8 dat)
{  
	
  uint32 i=0,j=0;
  for(i=0;i<8;i++)
     for(j=0;j<192;j++)gui_disp_buf[i][j]=dat;
   
   /* 填充LCM */
   LCD_FillAll(dat);
}


/****************************************************************************
* 名称：GUI_Initialize()
* 功能：初始化GUI，包括初始化显示缓冲区，初始化LCM并清屏。
* 入口参数：无
* 出口参数：无
****************************************************************************/
void  GUI_Initialize(void)
{  
	LCD_Initialize();					// 初始化LCM模块工作模式，纯图形模式
	GUI_FillSCR(0);					// 初始化缓冲区为0x00，并输出屏幕(清屏)
} 


/****************************************************************************
* 名称：GUI_ClearSCR()
* 功能：清屏。
* 入口参数：无
* 出口参数：无
* 说明：用户根据LCM的实际情况编写此函数。
****************************************************************************/
void  GUI_ClearSCR(void)
{  
	GUI_FillSCR(0x00);
}




//uint8 const  DCB_HEX_TAB[8] = {0x80, 0x40, 0x20, 0x10, 0x08, 0x04, 0x02, 0x01};
uint8 const  DCB_HEX_TAB[8] = {0x01, 0x02, 0x04, 0x08, 0x10, 0x20, 0x40, 0x80};

/****************************************************************************
* 名称：GUI_Point()
* 功能：在指定位置上画点。
* 入口参数： x		指定点所在列的位置
*           y		指定点所在行的位置
*           color	显示颜色(对于黑白色LCM，为0时灭，为1时显示)
* 出口参数：返回值为1时表示操作成功，为0时表示操作失败。(操作失败原因是指定地址超出有
*          效范围)
* 说明：用户根据LCM的实际情况编写此函数。对于单色，只有一个位有效，则要使用左移的方法
*      实现point_dat = (point_dat&MASK_TAB [i]) | (color<<n)，其它位数的一样
*      处理。
****************************************************************************/
uint8  GUI_Point(uint32 x, uint32 y, TCOLOR color)
{  
	uint8 chip_cs=0;
	uint8 YPage=0;
	uint8 i=0;
	uint8_t page_address	=0; 	// 页地址
	uint8_t column_address	=0; // 列地址

	/* 参数过滤 */
	if(x>=GUI_LCM_XMAX) return(0);
	if(y>=GUI_LCM_YMAX) return(0);
	
	page_address=y>>3;
	chip_cs=x>>6;
	x=x%64;
	y=y%8;

////	/* 设置缓冲区相应的点 */
	if( (color&0x01) != 0 ) 
		gui_disp_buf[page_address][x] |= DCB_HEX_TAB[y];
	else  
		gui_disp_buf[page_address][x] &= (~DCB_HEX_TAB[y]);

	LCD_WRReg(chip_cs,ADDR_PAGE|page_address);
	LCD_WRReg(chip_cs,ADDR_COLU|(x));
	LCD_WRRam (chip_cs, gui_disp_buf[page_address][x]);	 		 
 		 
   return(1);
}

/****************************************************************************
* 名称：GUI_ReadPoint()
* 功能：读取指定点的颜色。
* 入口参数：x			指定点所在列的位置
*          y		指定点所在行的位置
*          ret		保存颜色值的指针
* 出口参数：返回0时表示指定地址超出有效范围。
* 说明：对于单色，设置ret的d0位为1或0，4级灰度则为d0、d1有效，8位RGB则d0--d7有效，
*      RGB结构则R、G、B变量有效。
****************************************************************************/
int  GUI_ReadPoint(uint32 x, uint32 y, TCOLOR *ret)
{  
	TCOLOR  bak;
	uint8_t page_address	=0; 	// 页地址

   /* 参数过滤 */
   if(x>=GUI_LCM_XMAX) return(0);
   if(y>=GUI_LCM_YMAX) return(0);
	page_address=y>>3;
   /* 取得该点颜色(用户自行更改) */ 
   bak = gui_disp_buf[page_address][x%64];
   if( (bak&DCB_HEX_TAB[x&0x07])!=0 ) *ret = 1;
      else  *ret = 0;
   
   return(1);
}


/****************************************************************************
* 名称：GUI_HLine()
* 功能：画水平线。
* 入口参数： x0		水平线起点所在列的位置
*           y0		水平线起点所在行的位置
*           x1      水平线终点所在列的位置
*           color	显示颜色(对于黑白色LCM，为0时灭，为1时显示)
* 出口参数：无
* 说明：操作失败原因是指定地址超出缓冲区范围。
****************************************************************************/
void  GUI_HLine(uint32 x0, uint32 y0, uint32 x1, uint8 color) 
{  uint32  bak;

   if(x0>x1) 						// 对x0、x1大小进行排列，以便画图
   {  bak = x1;
      x1 = x0;
      x0 = bak;
   }
   if(x0==x1)
   {  GUI_Point(x0, y0, color);
      return;
   }
   
   do
   {  /* 设置相应的点为1 */
			GUI_Point(x0, y0,color);
      x0++;
   }while(x1>(x0-1));

}


/****************************************************************************
* 名称：GUI_RLine()
* 功能：画垂直线。
* 入口参数： x0		垂直线起点所在列的位置
*           y0		垂直线起点所在行的位置
*           y1      垂直线终点所在行的位置
*           color	显示颜色(对于黑白色LCM，为0时灭，为1时显示)
* 出口参数：无
* 说明：操作失败原因是指定地址超出缓冲区范围。
****************************************************************************/
void  GUI_RLine(uint32 x0, uint32 y0, uint32 y1, uint8 color) 
{  uint32  bak;

   if(y0>y1) 						// 对y0、y1大小进行排列，以便画图
   {  bak = y1;
      y1 = y0;
      y0 = bak;
   }
   if(y0==y1)
   {  GUI_Point(x0, y0, color);
      return;
   }
   
   do
   {  GUI_Point(x0, y0, color);		// 逐点显示，描出垂直线
      y0++;
   }while(y1>y0-1);
}

void  dis_rx_buf(uint8 dat)
{  
	uint32 x=0,y=0;
	
	unsigned char all=4;
	static unsigned char page=4; 
	unsigned char i=0,n=0;
	
  for(x=4;x<8;x++)
     for(y=0;y<192;y++)gui_disp_buf[x][y]=dat;
   
   /* 填充LCM */
	
 	while(all--)
	{
    for( n=0;n<3;n++)
		{  		 
     	LCD_WRReg (n,0xb8+page);            
	    LCD_WRReg (n,0x40+0);			 
	    for(i=0;i<64;i++) 
			{	
	        LCD_WRRam (n, gui_disp_buf[page][n*64+i]);	 		 
     	}
    }
		
	  page++;
		
	  if(page>=8)
			page=0;	 
	}
}
extern const uint8  FONT8x8ASCII[][8];
uint8  user_put_char8_8(uint32 x, uint32 y, uint8 ch)
{  uint8   font_dat;
   uint8   i, j;
   TCOLOR  bakc;

   /* 参数过滤 */
//   if( x>=(GUI_LCM_XMAX-8) ) return(x=0);
//   if( y>=(GUI_LCM_YMAX-8) ) return(0);
   if( (ch<0x20) || (ch>0x7f) ) ch = 0x20;
   
   ch -= 0x20; 
   for(i=0; i<8; i++)
   {  /* 读取点阵数据 */
      font_dat = FONT8x8ASCII[ch][i];
      
      for(j=0; j<8; j++)
      {  /* 设置相应的点为color或为back_color */
         if( (font_dat&DCB2HEX_TAB[j])==0 ) 
					 GUI_CopyColor(&bakc, back_color);
         else  
					 GUI_CopyColor(&bakc, disp_color);
				 
         GUI_Point(x, y, bakc);       
         x++;
      }
      
      y++;									// 指向下一行
      x -= 8;								// 恢复x值
   }
   
   return(1);
}




void  show_rx_buf(char *str)
{  
	uint32 x=0;
	uint32 y=32;	
	while(1)
   {  
		 if( (*str)=='\0' ) break;
		 if( (*str)=='\n' ) 
		 {
			x=0;
			y+=8;
		}

			user_put_char8_8(x, y, *str++);
      x += 8;								// 下一个字符显示位置，y不变(即不换行)
		 if(x>=(GUI_LCM_XMAX)) 
		 {
				x=0;
				y+=8;
		 }
		 
		 if(y>=(GUI_LCM_YMAX))
			y=32;
		 
   }
}


void  printf_rx_buf(char *str)
{  
	uint32 x=0;
	uint32 y=32;	
	while(1)
   {  
		 if( (*str)=='\0' ) break;
		 if( (*str)=='\n' ) 
		 {
			x=0;
			y=32;
			break;
		}

			user_put_char8_8(x, y, *str++);
      x += 8;								// 下一个字符显示位置，y不变(即不换行)
		 if(x>=(GUI_LCM_XMAX-8)) 
		 {
				x=0;
				y+=8;
		 }
		 
		 if(y>=(GUI_LCM_YMAX))
			y=32;
		 
   }
}