
//液晶模块型号：JLX12864G-086-PC
//液晶驱动IC:UC1701X，驱动IC的接口方式：串行接口（4线SPI)
//带字库IC:JLX-GB2312,字库IC的接口方式：串行接口（4线SPI)
//单片机（MCU):STM32F103RB
//版权所有：深圳市晶联讯电子有限公司，网址：http://www.jlxlcd.cn

#include "stm32f10x.h"

//#include <stm32f10x_lib.h>
#include <sys.h>
#include <delay.h>
#include "G_086_PC.h"
#include "Lcd.h"
#include "config.h"


uchar bmp_12864_1[]={
/*--  调入了一幅图像：D:\e\新开发部\显示图案收藏\12864_熊猫.bmp  --*/
/*--  宽度x高度=128x64  --*/
0x00,0x00,0x00,0x00,0x00,0x00,0x00,0x00,0x00,0x00,0x00,0x00,0x00,0x00,0x00,0x00,
0x00,0x00,0x80,0xC0,0xE0,0xF0,0xF8,0xF8,0xF8,0xFC,0xFC,0xFC,0xFC,0xF8,0xF8,0xF0,
0xF0,0xE0,0xC0,0xC0,0x40,0x40,0x40,0x40,0x40,0x40,0x40,0x40,0x40,0xC0,0x80,0x80,
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0x00,0x00,0x00,0x00,0x00,0x00,0x00,0x00,0x00,0x00,0x00,0x00,0x00,0x00,0x00,0x00,


};
uchar bmp_12864_2[]={
/*--  调入了一幅图像：D:\e\新开发部\显示图案收藏\12864G-202回字框.bmp  --*/
/*--  宽度x高度=128x64  --*/
0xFF,0x01,0x01,0x01,0x01,0xF9,0x09,0x09,0x09,0x09,0x89,0x89,0x89,0x89,0x89,0x89,
0x89,0x89,0x89,0x89,0x89,0x89,0x89,0x89,0x89,0x89,0x89,0x89,0x89,0x89,0x89,0x89,
0x89,0x89,0x89,0x89,0x89,0x89,0x89,0x89,0x89,0x89,0x89,0x89,0x89,0x89,0x89,0x89,
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0x91,0x91,0x91,0x91,0x91,0x91,0x90,0x90,0x90,0x90,0x9F,0x80,0x80,0x80,0x80,0xFF,

};
void waitkey(void)
{
//	repeat:
//		if(key2==1&&key3==1&&key4==1)	goto repeat;
//		else		DelayMS(600);
}


//初始化PA口为输出口.并使能这个IO口的时钟		    
//IO初始化
void lcd_port_init(void)
{
	GPIO_InitTypeDef GPIO_InitStructure;
	RCC_APB2PeriphClockCmd(RCC_APB2Periph_GPIOD, ENABLE)  ; 
	RCC_APB2PeriphClockCmd(RCC_APB2Periph_GPIOB, ENABLE)  ; 

	//LCD_PWR
	GPIO_InitStructure.GPIO_Pin = GPIO_Pin_7;
	GPIO_InitStructure.GPIO_Mode = GPIO_Mode_Out_PP;
	GPIO_InitStructure.GPIO_Speed = GPIO_Speed_50MHz;
	GPIO_Init(GPIOB, &GPIO_InitStructure);	
					LCD_PWR_ON() ;
					LCD_PWR_OFF() ;
					LCD_PWR_ON() ;


	//CS
	GPIO_InitStructure.GPIO_Pin = GPIO_Pin_3;
	GPIO_InitStructure.GPIO_Mode = GPIO_Mode_Out_PP;
	GPIO_InitStructure.GPIO_Speed = GPIO_Speed_50MHz;
	GPIO_Init(GPIOD, &GPIO_InitStructure);
	//RST
	GPIO_InitStructure.GPIO_Pin = GPIO_Pin_4;
	GPIO_InitStructure.GPIO_Mode = GPIO_Mode_Out_PP;
	GPIO_InitStructure.GPIO_Speed = GPIO_Speed_50MHz;
	GPIO_Init(GPIOD, &GPIO_InitStructure);
	//RS
	GPIO_InitStructure.GPIO_Pin = GPIO_Pin_5;
	GPIO_InitStructure.GPIO_Mode = GPIO_Mode_Out_PP;
	GPIO_InitStructure.GPIO_Speed = GPIO_Speed_50MHz;
	GPIO_Init(GPIOD, &GPIO_InitStructure);
	
	//SDA SCK
	GPIO_InitStructure.GPIO_Pin = GPIO_Pin_6 | GPIO_Pin_7;
	GPIO_InitStructure.GPIO_Mode = GPIO_Mode_Out_PP;
	GPIO_InitStructure.GPIO_Speed = GPIO_Speed_50MHz;
	GPIO_Init(GPIOD, &GPIO_InitStructure);
	

//#define Rom_CS			PBout(8)  	// PA5对应字库IC接口"Rom_CS"(也即：字库IC的CS#）
//#define Rom_SCK			PBout(9)  	// PA6对应字库IC接口"Rom_SCK"（也即：字库IC的SCK）
//#define Rom_OUT			PEin(0)  	// PA7对应字库IC接口"Rom_OUT"（也即：字库IC的SO。SPI接口的"MISO" ）
//#define Rom_IN			PEout(1)  	// PC4对应字库IC接口"Rom_IN"（也即：字库IC的SI。SPI接口的"MOSI"）


	GPIO_InitStructure.GPIO_Pin = GPIO_Pin_8 | GPIO_Pin_9;
	GPIO_InitStructure.GPIO_Mode = GPIO_Mode_Out_PP;
	GPIO_InitStructure.GPIO_Speed = GPIO_Speed_50MHz;
	GPIO_Init(GPIOB, &GPIO_InitStructure);
	
	GPIO_InitStructure.GPIO_Pin = GPIO_Pin_1;
	GPIO_InitStructure.GPIO_Mode = GPIO_Mode_Out_PP;
	GPIO_InitStructure.GPIO_Speed = GPIO_Speed_50MHz;
	GPIO_Init(GPIOE, &GPIO_InitStructure);


	GPIO_InitStructure.GPIO_Pin = GPIO_Pin_0;
	GPIO_InitStructure.GPIO_Mode = GPIO_Mode_IPU;
	GPIO_InitStructure.GPIO_Speed = GPIO_Speed_50MHz;
	GPIO_Init(GPIOE, &GPIO_InitStructure);
}




//写指令到LCD模块
void transfer_command_lcd(int data1)   
{
	uchar i;
	lcd_cs1=0;
	lcd_rs=0;
	for(i=0;i<8;i++)
   {
		lcd_sclk=0;
		if(data1&0x80) lcd_sid=1;
		else lcd_sid=0;
		lcd_sclk=1;
	 	data1<<=1;
   }
	lcd_cs1=1;
}

//写数据到LCD模块
void transfer_data_lcd(int data1)
{
	uchar i;
	lcd_cs1=0;
	lcd_rs=1;
	for(i=0;i<8;i++)
   {
		lcd_sclk=0;
		if(data1&0x80) lcd_sid=1;
		else lcd_sid=0;
		lcd_sclk=1;
	 	data1<<=1;
    }
	lcd_cs1=1;
}


//LCD模块初始化
void initial_lcd()
{
	lcd_reset=0;        					//低电平复位
  DelayMS(1);
  lcd_reset=1;		    					//复位完毕
  DelayMS(1);        
	transfer_command_lcd(0xe2);	 //软复位
	DelayMS(1);
	transfer_command_lcd(0x2c);  //升压步聚1
	DelayMS(1);	
	transfer_command_lcd(0x2e);  //升压步聚2
	DelayMS(1);
	transfer_command_lcd(0x2f);  //升压步聚3
	DelayMS(1);
	transfer_command_lcd(0x23);  //粗调对比度，可设置范围0x20～0x27
	transfer_command_lcd(0x81);  //微调对比度
	transfer_command_lcd(0x28);  //JLX12864G-086的微调的对比度值为0x28,微调对比度的值可设置范围为0x00～0x3f
	transfer_command_lcd(0xa2);  //1/9偏压比（bias）
	transfer_command_lcd(0xc8);  //行扫描顺序：从上到下
	transfer_command_lcd(0xa0);  //列扫描顺序：从左到右
	transfer_command_lcd(0x40);  //起始行：第一行开始
	transfer_command_lcd(0xaf);  //开显示
}

//设置液晶屏的显示地址（page，column）
void lcd_address(uchar page,uchar column)
{
	column=column-1;  							
	page=page-1;
	transfer_command_lcd(0xb0+page);   				//设置页地址。每页是8行。一个画面的64行被分成8个页。我们平常所说的第1页，在LCD驱动IC里是第0页，所以在这里减去1
	transfer_command_lcd(((column>>4)&0x0f)+0x10);	//设置列地址的高4位
	transfer_command_lcd(column&0x0f);				//设置列地址的低4位
}

//全屏清屏
void clear_screen()
{
	uchar i,j;
 	for(i=0;i<9;i++)
	{
		lcd_address(1+i,1);
		for(j=0;j<132;j++)
		{
			transfer_data_lcd(0x00);
		}
	}
}
//一些出厂电测用的画面，比如全显，隔行显示，隔列显示等等
void full_screen_test(uchar data1,uchar data2)
{
	uchar i,j;
 	for(i=0;i<9;i++)
	{
		lcd_address(1+i,1);
		for(j=0;j<64;j++)
		{
			transfer_data_lcd(data1);
			transfer_data_lcd(data2);
		}
	}
}

//一些出厂电测用的画面，比如全显，隔行显示，隔列显示等等
void test(void)
{
		full_screen_test(0xff,0xff);
		DelayMS(500);
		

		full_screen_test(0x55,0x55);
		DelayMS(500);
		

		full_screen_test(0xaa,0xaa);
		DelayMS(500);
		

		full_screen_test(0xff,0x00);
		DelayMS(500);
		

		full_screen_test(0x00,0xff);
		DelayMS(500);
		

		full_screen_test(0x55,0xaa);
		DelayMS(500);
		

		full_screen_test(0xaa,0x55);
		DelayMS(500);
		
}

//显示128x64点阵图像
void display_graphic_128x64(uchar page,uchar column,uchar *dp)
{
	int i,j;
	for(j=0;j<8;j++)
	{
		lcd_address(page+j,column);
		for(i=0;i<128;i++)
		{
			transfer_data_lcd(*dp);   
			dp++;
		}
	}          
}

//***送指令到晶联讯字库IC**
void send_command_to_ROM( uchar datu )
{
	uchar i;
	for(i=0;i<8;i++ )
	{
		Rom_SCK=0;
		User_DelayuS(1);
		if(datu&0x80)Rom_IN = 1;
		else Rom_IN = 0;
		datu = datu<<1;
		Rom_SCK=1;
		User_DelayuS(1);
	}
}

//***从晶联讯字库IC中取汉字或字符数据（1个字节）**
static uchar get_data_from_ROM( )
{
	
	uchar i;
	uchar ret_data=0;
	for(i=0;i<8;i++)
	{
		Rom_OUT=1;
		Rom_SCK=0;
		User_DelayuS(1);
		ret_data=ret_data<<1;
		if( Rom_OUT )
			ret_data=ret_data+1;
		else
			ret_data=ret_data+0;
		Rom_SCK=1;
		User_DelayuS(1);
	}
	return(ret_data);
}


//从指定地址读出数据写到液晶屏指定（page,column)座标中
void get_and_write_16x16(ulong fontaddr,uchar reverse,uchar page,uchar column)
{
	uchar i,j,disp_data;
	Rom_CS = 0;
	send_command_to_ROM(0x03);
	send_command_to_ROM((fontaddr&0xff0000)>>16);	 //地址的高8位,共24位
	send_command_to_ROM((fontaddr&0xff00)>>8);		 //地址的中8位,共24位
	send_command_to_ROM(fontaddr&0xff);				 		//地址的低8位,共24位
	for(j=0;j<2;j++)
	{
		lcd_address(page+j,column);
		for(i=0; i<16; i++ )
	    {
			if(reverse==1)
			{
				disp_data=~get_data_from_ROM();
			}
			else
			{
				disp_data=get_data_from_ROM();
			}
			transfer_data_lcd(disp_data);	//写数据到LCD,每写完1字节的数据后列地址自动加1
		}
	}
	Rom_CS=1;
}

//从指定地址读出数据写到液晶屏指定（page,column)座标中
void get_and_write_8x16(u32 fontaddr,uchar reverse,uchar page,uchar column)
{
	uchar i,j,disp_data;
	Rom_CS = 0;
	send_command_to_ROM(0x03);
	send_command_to_ROM((fontaddr&0xff0000)>>16);	 //地址的高8位,共24位
	send_command_to_ROM((fontaddr&0xff00)>>8);		 //地址的中8位,共24位
	send_command_to_ROM(fontaddr&0xff);				 //地址的低8位,共24位
	for(j=0;j<2;j++)
	{
		lcd_address(page+j,column);
		for(i=0; i<8; i++ )
	    {
			if(reverse==1)
			{
				disp_data=~get_data_from_ROM();
			}
			else
			{
				disp_data=get_data_from_ROM();
			}
			transfer_data_lcd(disp_data);	//写数据到LCD,每写完1字节的数据后列地址自动加1
		}
	}
	Rom_CS=1;
}

//从指定地址读出数据写到液晶屏指定（page,column)座标中
void get_and_write_5x8(u32 fontaddr,uchar reverse,uchar page,uchar column) 
{
	uchar i,disp_data;
	Rom_CS = 0;
	send_command_to_ROM(0x03);
	send_command_to_ROM((fontaddr&0xff0000)>>16);	 //地址的高8位,共24位
	send_command_to_ROM((fontaddr&0xff00)>>8);		 //地址的中8位,共24位
	send_command_to_ROM(fontaddr&0xff);				 //地址的低8位,共24位
	lcd_address(page,column);
	for(i=0; i<5; i++ )
	{
		if(reverse==1)
		{
			disp_data=~get_data_from_ROM();
		}
		else
		{
			disp_data=get_data_from_ROM();
		}

		transfer_data_lcd(disp_data);	//写数据到LCD,每写完1字节的数据后列地址自动加1
	}
	Rom_CS=1;
}


//****************************************************************

//显示16x16点阵的汉字/全角符号/全角标点，或8x16点阵的数字/英文/半角标点/ASCII码符号，
//当“reverse=1”时选择反显，当“reverse=0”时选择正显
u32  fontaddr=0;
void display_GB2312_string(uchar page,uchar column,uchar reverse,uchar *text)
{
	uchar i= 0;			
	while((text[i]>0x00)&&i<16)
	{
		if(((text[i]>=0xb0) &&(text[i]<=0xf7))&&(text[i+1]>=0xa1))
		{						
			//国标简体（GB2312）汉字在晶联讯字库IC中的地址由以下公式来计算：
			//Address = ((MSB - 0xB0) * 94 + (LSB - 0xA1)+ 846)*32+ BaseAdd;BaseAdd=0
			//由于担心8位单片机有乘法溢出问题，所以分三部取地址
			fontaddr = (text[i]- 0xb0)*94; 
			fontaddr += (text[i+1]-0xa1)+846;
			fontaddr = (u32)(fontaddr*32);

			get_and_write_16x16(fontaddr,reverse,page,column);	 //从指定地址读出数据写到液晶屏指定（page,column)座标中
			i+=2;
			column+=16;
		}
		else if(((text[i]>=0xa1) &&(text[i]<=0xa3))&&(text[i+1]>=0xa1))
		{						
			//国标简体（GB2312）15x16点的字符在晶联讯字库IC中的地址由以下公式来计算：
			//Address = ((MSB - 0xa1) * 94 + (LSB - 0xA1))*32+ BaseAdd;BaseAdd=0
			//由于担心8位单片机有乘法溢出问题，所以分三部取地址
			fontaddr = (text[i]- 0xa1)*94; 
			fontaddr += (text[i+1]-0xa1);
			fontaddr = (u32)(fontaddr*32);
	
			get_and_write_16x16(fontaddr,reverse,page,column);	 //从指定地址读出数据写到液晶屏指定（page,column)座标中
			i+=2;
			column+=16;
		}
		else if((text[i]>=0x20) &&(text[i]<=0x7e))	
		{									
			fontaddr = (text[i]- 0x20);
			fontaddr = (ulong)(fontaddr*16);
			fontaddr = (unsigned long)(fontaddr+0x3cf80);			

			get_and_write_8x16(fontaddr,reverse,page,column);	 //从指定地址读出数据写到液晶屏指定（page,column)座标中
			i+=1;
			column+=8;
		}
		else
			i++;	
	}
}

//显示5x8点阵数字/半角符号/半角标点
//当“reverse=1”时选择反显，当“reverse=0”时选择正显
void display_string_5x8(uchar page,uchar column,uchar reverse,uchar *text)
{
	uchar i= 0;

	while((text[i]>0x00))
	{
		
		if((text[i]>=0x20) &&(text[i]<=0x7e))	
		{						
			fontaddr = (text[i]- 0x20);
			fontaddr = (ulong long)(fontaddr*8);
			fontaddr = (ulong long)(fontaddr+0x3bfc0);			


			get_and_write_5x8(fontaddr,reverse,page,column);	 //从指定地址读出数据写到液晶屏指定（page,column)座标中
			if(reverse==1)	
				transfer_data_lcd(0xff);
			else	
				transfer_data_lcd(0x00);
			i+=1;
			column+=6;
		}
		else
		i++;	
	}
}

extern void display_string_5x8(uchar page,uchar column,uchar reverse,uchar *text);


//				display_string_5x8(page,column,0,*str++);	    
void display_char_5x8(uchar page,uchar column,uchar reverse,uchar text)
{
		if((text>=0x20) &&(text<=0x7e))	
		{						
			fontaddr = (text- 0x20);
			fontaddr = (ulong long)(fontaddr*8);
			fontaddr = (ulong long)(fontaddr+0x3bfc0);			


			get_and_write_5x8(fontaddr,reverse,page,column);	 //从指定地址读出数据写到液晶屏指定（page,column)座标中
			if(reverse==1)	
				transfer_data_lcd(0xff);
			else	
				transfer_data_lcd(0x00);
		}
	
}



//void  lcd_show_rx_buf(char *str)
//{  
//	uint32 page=6;  //4,5,6,7,
//	uint32 column=1;	
//	
//	while(1)
//   {  
//		 if( (*str)=='\0' ) break;
//		 if( (*str)=='\n' ) 
//		 {
//			page=4;
//			column=1;
//			break;
//		}
//		display_char_5x8(page,column,0,*str++);	    
//      column += 6;								// 下一个字符显示位置，y不变(即不换行)
//		 if(column>=(GUI_LCM_XMAX-8)) 
//		 {
//				page++;
//				column=1;
//		 }
//		 
//		 if(page>7)
//			page=6;
//		 
//   }
//}
void  lcd_show_rx_buf(char *str)
{  
	uint32 page=8;  //4,5,6,7,
	uint32 column=1;	
	
	while(1)
   {  
		 if( (*str)=='\0' ) break;

		display_char_5x8(page,column,0,*str++);	    
      column += 6;								// 下一个字符显示位置，y不变(即不换行)
		 if(column>=(GUI_LCM_XMAX-8)) 
		 {
				column=1;
		 }
   }
}

